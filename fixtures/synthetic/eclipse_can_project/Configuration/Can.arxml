AUTOSAR XML (schema 4.0)
package /Can
  module config Can
    CanConfigSet: CanDevErrorDetect=true
