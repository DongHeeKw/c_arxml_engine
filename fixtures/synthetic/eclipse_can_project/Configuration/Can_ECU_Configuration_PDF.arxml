AUTOSAR XML (schema 4.0)
package /EcucDefs
  module definition Can
    container CanConfigSet [1..*]
      boolean CanDevErrorDetect: default-value=true
